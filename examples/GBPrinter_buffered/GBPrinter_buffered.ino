/* This is based on the works of Miles Burton and the furrtek gang/guy.
 * I made this a library for easier integration into sketches
 * TODO: 
 * TextToPrint ( thats what the alphabet array is for)
 * 
 * 
 * Byte1 0x0101 0101
 * Byte2 0x0011 0011
 * color   0123 0123
 * 
 * http://www.milesburton.com/Gameboy_Printer_with_Arduino
 */
 
#include <GBPrinter.h>
#include <avr/pgmspace.h>


//uint8_t c,b,cmd,repl,buffer[64];
uint8_t cmd;
uint16_t CRC;

/*
  copy the hex output from http://davedarko.com/gameboy.php here
  but make sure your arduino really got the byte size memory
  I "bricked" a fake arduino uploading a script that was supposed to be 
  smaller then the max amount.
*/

prog_char row0[640] PROGMEM = {
0x00, 0x00, 0x00, 0x00, 0x00, 0x00, 0x00, 0x00, 0x00, 0x00, 0x00, 0x00,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 0x00, 
};
prog_char row1[640] PROGMEM = {
0x00, 0x20, 0x00, 0x50, 0x00, 0x00, 0x00, 0x20, 0x00, 0x54, 0x00, 0x22,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 0x00, 
};
prog_char row2[640] PROGMEM = {
0x00, 0xDB, 0x00, 0xA5, 0x00, 0x5B, 0x00, 0x2F, 0x00, 0xD5, 0x00, 0x2B,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 0x00, 
};
prog_char row3[640] PROGMEM = {
0xFF, 0x00, 0xFF, 0x00, 0xFF, 0xD2, 0xFF, 0xA4, 0xFF, 0xD2, 0xFF, 0xC8,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 0x0E, 
};
prog_char row4[640] PROGMEM = {
0xFF, 0xFF, 0xFF, 0xED, 0xFF, 0xFA, 0xFF, 0xD6, 0xFF, 0xEC, 0xFF, 0xDA,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 0xD0, 
};
prog_char row5[640] PROGMEM = {
0x00, 0x6D, 0x00, 0x35, 0x00, 0xDA, 0x00, 0x2B, 0x00, 0x57, 0x00, 0x3E,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 0x40, 
};
prog_char row6[640] PROGMEM = {
0x00, 0xEC, 0x00, 0xBB, 0x00, 0x6A, 0x00, 0x2D, 0x00, 0xDB, 0x00, 0x36,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 0x92, 
};
prog_char row7[640] PROGMEM = {
0x04, 0xFB, 0x09, 0xF6, 0x00, 0xFF, 0x02, 0xFD, 0x00, 0xFF, 0x00, 0xFF,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 0x00, 
};

PROGMEM const prog_char *row_table[] = 	   // change "string_table" name to suit
{   
  row0,
  row1,
  row2,
  row3,
  row4,
  row5,
  row6,
  row7
};

uint8_t buffer[640];




void setup() {
  setupPrinter(GBIn, GBOut, GBClock);
  Serial.begin(9600);
   

}

void loop() {
  //Serial.println("Gameboy Printer for Arduino");
   
  if (Serial.available() > 0) {

    cmd = Serial.read();

    if(cmd == 'h') {
      hadcon();
    }
    if(cmd == 'g') {
      for (int j=0;j<8;j++) {
        for (int i=0;i<640;i++) {
          buffer[i] = pgm_read_byte_near(pgm_read_word(row_table +j) + i);
          Serial.print(buffer[i], HEX);
          Serial.print(' ');          
        }
        Serial.println();
      }
    }
  }
}

void sendRow (uint8_t row2send[]) {
    CRC = 0;
    Serial.println("Data");
    CRC += beginData();
    for(int i=0; i<640; ++i) {
      uint8_t cmd = row2send[i];
      CRC += cmd;
      GBSerialOut(cmd);
    }

    if(endData(CRC)) //0x27E06
    { 
      Serial.println("Data sent");
    }
    printStatusCode(-1);
}

void hadcon() {
  sendInitialize();
  getStatusCode();
  
  for (int j=0;j<8;j++) {
    for (int i=0;i<640;i++) {
      buffer[i] = pgm_read_byte_near(pgm_read_word(row_table +j) + i);
    }
    sendRow(buffer);
  }
  
  sendInquiry();
  GBPCommand(GBData,0);
  printStatusCode(-1);
  sendPrint(1,3,0xE4,0x40);
  printStatusCode(-1);
}