  /* This is based on the works of Miles Burton and the furrtek gang/guy.
   * I made this a library for easier integration into sketches
   * TODO: 
   * TextToPrint ( thats what the alphabet array is for)
   * 
   * 
   * Byte1 0x0101 0101
   * Byte2 0x0011 0011
   * color   0123 0123
   * 
   * http://www.milesburton.com/Gameboy_Printer_with_Arduino
   */
   
  #include <GBPrinter.h>
  #include <avr/pgmspace.h>


  //uint8_t c,b,cmd,repl,buffer[64];
  uint8_t cmd;
  uint16_t CRC;

  /*
    copy the hex output from http://davedarko.com/gameboy.php here
    but make sure your arduino really got the byte size memory
    I "bricked" a fake arduino uploading a script that was supposed to be 
    smaller then the max amount.
  */

  prog_char row0[640] PROGMEM = {
  0xA5, 0x5A, 0x00, 0xFF, 0x91, 0x6E, 0x04, 0xFB, 0x80, 0x7F, 0x82, 0x7D,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 0x00, 
  };
  prog_char row1[640] PROGMEM = {
  0x80, 0x7F, 0x02, 0xFD, 0x08, 0xF7, 0x80, 0x7F, 0x85, 0x7A, 0x00, 0xFF,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 0x08, 
  };
  prog_char row2[640] PROGMEM = {
  0x90, 0x6F, 0x01, 0xFE, 0x88, 0x77, 0x02, 0xFD, 0x80, 0x7F, 0x48, 0xB7,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 0x85, 
  };
  prog_char row3[640] PROGMEM = {
  0x49, 0xB6, 0xA4, 0x5B, 0x08, 0xF7, 0xA0, 0x5F, 0x02, 0xFD, 0xA8, 0x57,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 0x00, 
  };
  prog_char row4[640] PROGMEM = {
  0x02, 0xFD, 0x90, 0x6F, 0x80, 0x7F, 0x22, 0xDD, 0x84, 0x7B, 0x10, 0xEF,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 0xBB, 
  };
  prog_char row5[640] PROGMEM = {
  0x49, 0xB6, 0x80, 0x7F, 0x14, 0xEB, 0x81, 0x7E, 0x50, 0xAF, 0x89, 0x76,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 0x48, 
  };
  prog_char row6[640] PROGMEM = {
  0x82, 0x7D, 0x29, 0xD6, 0x80, 0x7F, 0x2A, 0xD5, 0x80, 0x7F, 0x52, 0xAD,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 0xDA, 
  };
  prog_char row7[640] PROGMEM = {
  0x82, 0x7D, 0x28, 0xD7, 0x85, 0x7A, 0x80, 0x7F, 0x54, 0xAB, 0x01, 0xFE,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 0xF6, 
  };
  prog_char row8[640] PROGMEM = {
  0x81, 0x7E, 0x54, 0xAB, 0x80, 0x7F, 0x2A, 0xD5, 0x80, 0x7F, 0x29, 0xD6,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 0x41, 
  };
  prog_char row9[640] PROGMEM = {
  0x91, 0x6E, 0x24, 0xDB, 0x82, 0x7D, 0x54, 0xAB, 0x80, 0x7F, 0x55, 0xAA,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 0xA3, 
  };
  prog_char row10[640] PROGMEM = {
  0x92, 0x6D, 0x11, 0xEE, 0xA4, 0x5B, 0x92, 0x6D, 0x44, 0xBB, 0x91, 0x6E,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 0xFF, 
  };
  prog_char row11[640] PROGMEM = {
  0x80, 0x7C, 0x50, 0xA9, 0x80, 0x7A, 0x40, 0xB2, 0x80, 0x64, 0x00, 0xD4,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 0x5A, 
  };
  prog_char row12[640] PROGMEM = {
  0x42, 0xBD, 0x94, 0x6B, 0x42, 0xBD, 0x94, 0x6B, 0x51, 0xAE, 0x88, 0x77,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 0x65, 
  };
  prog_char row13[640] PROGMEM = {
  0x52, 0xAD, 0x94, 0x6B, 0x51, 0xAE, 0x88, 0x77, 0x55, 0xAA, 0xA2, 0x5D,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 0x55, 
  };
  prog_char row14[640] PROGMEM = {
  0xA4, 0x5B, 0xA9, 0x56, 0x49, 0xB6, 0xA4, 0x5B, 0x92, 0x6D, 0xA9, 0x56,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 0xAA, 
  };
  prog_char row15[640] PROGMEM = {
  0x94, 0x6B, 0xA2, 0x5D, 0x95, 0x6A, 0xA9, 0x56, 0x94, 0x6B, 0x4A, 0xB5,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 0x5A, 
  };
  prog_char row16[640] PROGMEM = {
  0xA2, 0x5D, 0x98, 0x66, 0xA4, 0x5A, 0x90, 0x6C, 0xA8, 0x54, 0xA8, 0x54,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 0x55, 
  };
  prog_char row17[640] PROGMEM = {
  0xA9, 0x56, 0xAA, 0x55, 0xAA, 0x55, 0xA9, 0x56, 0xA5, 0x5A, 0xAA, 0x55,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 0x00, 
  };

  PROGMEM const prog_char *row_table[] =     // change "string_table" name to suit
  {   
    row0,
    row1,
    row2,
    row3,
    row4,
    row5,
    row6,
    row7,
    row8,
    row9,
      row10,
    row11,
    row12,
    row13,
    row14,
    row15,
    row16,
    row17,
  };

  uint8_t buffer[640];

  void setup() {
    setupPrinter(GBIn, GBOut, GBClock);
    Serial.begin(9600);
    Serial.println("Gameboy Printer for Arduino"); 
    Serial.println("Enter 'h' to print array"); 
  }

  void loop() {
    
    if (Serial.available() > 0) {

      cmd = Serial.read();

      if(cmd == 'h') {
        hadcon();
      }

    }
  }

  void sendRow (uint8_t row2send[]) {
      CRC = 0;
      Serial.println("Data");
      CRC += beginData();
      for(int i=0; i<640; ++i) {
        uint8_t cmd = row2send[i];
        CRC += cmd;
        GBSerialOut(cmd);
      }

      if(endData(CRC)) //0x27E06
      { 
        Serial.println("Data sent");
      }
      printStatusCode(-1);
  }

  void hadcon() {
    
    for (int j=0;j<17;j++) {
      
      for (int i=0;i<640;i++) {
        buffer[i] = pgm_read_byte_near(pgm_read_word(row_table +j) + i);
      }
      
      sendInitialize();
      
      getStatusCode();

      sendRow(buffer);    
      
      sendInquiry();
      GBPCommand(GBData,0);
      printStatusCode(-1);

      
      uint8_t margin_left = 1;
      uint8_t margin_right = 3;
      if (j == 0) {
        sendPrint(margin_left,0,0xE4,0x40);      
      }
      else if (j == 16) {
        sendPrint(0,margin_right,0xE4,0x40);      
      }
      else {
        sendPrint(0,0,0xE4,0x40);      
      }

      // code from furrtek, wait for line to finish and print on
      while(1) {
         uint8_t inq = sendInquiry();
         if (inq & 2) {
           break;
         }
         delay(100);
         // printing started
      }
      while(1) {
         uint8_t inq = sendInquiry();
         if (!(inq & 2)) {
           break;
         }
         delay(100);
      }
    }
  }